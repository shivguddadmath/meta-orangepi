## conf/layer.conf
```bitbake
# We have a conf and classes directory, append to BBPATH
BBPATH .= ":${LAYERDIR}"

# We have a recipes directory, add to BBFILES
BBFILES += "${LAYERDIR}/recipes*/*/*.bb ${LAYERDIR}/recipes*/*/*.bbappend"

BBFILE_COLLECTIONS += "meta-orangepi"
BBFILE_PATTERN_meta-orangepi := "^${LAYERDIR}/"
BBFILE_PRIORITY_meta-orangepi = "1"

LAYERSERIES_COMPAT_meta-orangepi = "zeus dunfell"
```

## conf/machine/include/orangepi-4.inc
```bitbake
SOC_FAMILY = "rk3399"

require conf/machine/include/arm/arch-armv8a.inc
require conf/machine/include/soc-family.inc

MACHINEOVERRIDES =. "mali-gpu:mali-midgard:"

PREFERRED_PROVIDER_virtual/kernel = "linux-orangepi-4-lts"
PREFERRED_VERSION_linux-orangechip = "4.4"

SERIAL_CONSOLES = "1500000;ttyFIQ0"
KERNEL_IMAGETYPE = "Image"
KBUILD_DEFCONFIG = "rk3399_linux_defconfig"

PREFERRED_PROVIDER_virtual/bootloader ?= "u-boot-orangepi-4-lts"

MACHINE_ESSENTIAL_EXTRA_RRECOMMENDS += "\
   kernel-modules \
   resize-helper \
"

IMAGE_FSTYPES += "rockchip-orangepi-gpt-img"
IMAGE_CLASSES += "rockchip-orangepi-gpt-img"
```

## conf/machine/orangepi-4-lts.conf
```bitbake
#@TYPE: Machine
#@NAME: OrangePi 4 LTS machine
#@DESCRIPTION: OrangePi 4 LTS development board config file

require conf/machine/include/orangepi-4.inc

KERNEL_DEVICETREE = "rk3399-orangepi.dtb"
UBOOT_MACHINE = "rk3399_linux_defconfig"

MACHINE_ESSENTIAL_EXTRA_RRECOMMENDS += "\
   brcm-tools \
   brcmfmac \
   rkwifibt-firmware-ap6212a1-wifi \
   rkwifibt-firmware-ap6212a1-bt \
   rkwifibt-firmware-ap6256-wifi \
   rkwifibt-firmware-ap6256-bt \
   bluetooth-broadcom \
"
```
